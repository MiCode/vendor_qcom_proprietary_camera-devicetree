/dts-v1/;
/plugin/;

#include "bengal-camera.dtsi"
#include "bengal-camera-4250.dtsi"
/ {
        model = "Qualcomm Technologies, Inc. Bengal SoC";
        compatible = "qcom,bengal";
        qcom,msm-id = <417 0x10000>;
        qcom,board-id = <0 0>;
};

