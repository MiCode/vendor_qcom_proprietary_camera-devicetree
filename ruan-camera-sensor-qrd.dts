/dts-v1/;
/plugin/;

#include <dt-bindings/clock/qcom,gcc-parrot.h>
#include <dt-bindings/clock/qcom,camcc-parrot.h>
#include <dt-bindings/interconnect/qcom,parrot.h>
#include <dt-bindings/interrupt-controller/arm-gic.h>
#include <dt-bindings/regulator/qcom,rpmh-regulator-levels.h>

#include "ruan-camera-sensor-qrd.dtsi"
/ {
	model = "Qualcomm Technologies, Inc. Parrot QRDi RUAN based on SM7435";
	compatible = "qcom,parrot";
	qcom,msm-id = <537 0x10000>, <583 0x10000>, <613 0x10000>, <631 0x10000>, <633 0x10000>, <634 0x10000>, <638 0x10000>;
	qcom,board-id = <0x3000B 0>, <0x3000B 1>, <0x3000B 0x600>, <0x3000B 0x601>;
};
