/dts-v1/;
/plugin/;

#include "creek-camera-sensor-idp.dtsi"
/ {
	model = "Qualcomm Technologies, Inc. Khaje IDP creek";
	compatible = "qcom,khaje-idp", "qcom,khaje", "qcom,idp";
	qcom,msm-id = <518 0x10000>, <586 0x10000>;
	qcom,board-id = <0x20022 0>, <0x20122 0>;
	qcom,pmic-id = <0x2D 0x0 0x0 0x0>;
};

