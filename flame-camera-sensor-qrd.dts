/dts-v1/;
/plugin/;

#include <dt-bindings/clock/qcom,gcc-ravelin.h>
#include <dt-bindings/clock/qcom,camcc-ravelin.h>
#include <dt-bindings/interconnect/qcom,ravelin.h>
#include <dt-bindings/interrupt-controller/arm-gic.h>
#include <dt-bindings/regulator/qcom,rpmh-regulator-levels.h>

#include "flame-camera-sensor-qrd.dtsi"
/ {
	model = "Qualcomm Technologies, Inc. Flame QRD";
	compatible = "qcom,raveline";
	qcom,msm-id = <568 0x10000>, <581 0x10000>, <582 0x10000>;
	qcom,board-id = <0x2000B 0>, <0x2000B 1>, <0x2000B 0x600>;
};
