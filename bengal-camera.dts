/dts-v1/;
/plugin/;

#include "bengal-camera.dtsi"
/ {
	model = "Qualcomm Technologies, Inc. Bengal SoC";
	compatible = "qcom,bengal";
	qcom,msm-id = <444 0x10000>, <469 0x10000>, <470 0x10000>;
	qcom,board-id = <0 0>;
};

